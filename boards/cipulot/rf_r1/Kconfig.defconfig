## boards/cipulot/rf_r1/Kconfig.defconfig
```kconfig
if BOARD_RF_R1

config ZMK_KEYBOARD_NAME
	default "Cipulot RF R1"

config ZMK_USB
	default y

config ZMK_HID_INDICATORS
	default y

endif # BOARD_RF_R1
```

## boards/cipulot/rf_r1/Kconfig.rf_r1
```kconfig
config BOARD_RF_R1
	select SOC_STM32F411XE
	select ADC
	select ZMK_BOARD_COMPAT
	imply RETAINED_MEM
	imply RETENTION
	imply RETENTION_BOOT_MODE
```

## boards/cipulot/rf_r1/board.yml
```yaml
board:
  name: rf_r1
  full_name: Cipulot RF R1
  vendor: cipulot
  socs:
    - name: stm32f411xe
      variants:
        - name: 87u
```
