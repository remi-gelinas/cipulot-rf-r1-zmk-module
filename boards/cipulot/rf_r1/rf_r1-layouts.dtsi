#include <physical_layouts.dtsi>

/* Rows 0-4, ANSI geometry. Shared by all ANSI R1 variants. */
#define XFORM_ALPHA_ANSI                                                        \
    RC(0, 0) RC(0, 1) RC(0, 2) RC(0, 3) RC(0, 4) RC(0, 5) RC(0, 6) RC(0, 7)     \
    RC(0, 8) RC(0, 9) RC(0,10) RC(0,11) RC(0,12) RC(0,13) RC(0,14) RC(0,15)     \
    RC(1, 0) RC(1, 1) RC(1, 2) RC(1, 3) RC(1, 4) RC(1, 5) RC(1, 6) RC(1, 7)     \
    RC(1, 8) RC(1, 9) RC(1,10) RC(1,11) RC(1,12) RC(1,14) RC(3,14) RC(2,15)     \
    RC(1,15)                                                                    \
    RC(2, 0) RC(2, 1) RC(2, 2) RC(2, 3) RC(2, 4) RC(2, 5) RC(2, 6) RC(2, 7)     \
    RC(2, 8) RC(2, 9) RC(2,10) RC(2,11) RC(2,12) RC(2,13) RC(4,14) RC(4,15)     \
    RC(3,15)                                                                    \
    RC(3, 0) RC(3, 1) RC(3, 2) RC(3, 3) RC(3, 4) RC(3, 5) RC(3, 6) RC(3, 7)     \
    RC(3, 8) RC(3, 9) RC(3,10) RC(3,11) RC(3,13)                                \
    RC(4, 0) RC(4, 2) RC(4, 3) RC(4, 4) RC(4, 5) RC(4, 6) RC(4, 7) RC(4, 8)     \
    RC(4, 9) RC(4,10) RC(4,11) RC(4,13) RC(5,14)

/* 87U row 5: LCtrl LGui LAlt Space RAlt RGui Menu RCtrl ← ↓ →  */
#define XFORM_BOTTOM_87U                                                        \
    RC(5, 0) RC(5, 1) RC(5, 2) RC(5, 6) RC(5, 8) RC(5, 9) RC(5,10) RC(5,11)     \
    RC(5,12) RC(5,13) RC(5,15)

#define TRANSFORM(_name, _alpha, _bottom)                                       \
    _name: _name {                                                              \
        compatible = "zmk,matrix-transform";                                    \
        rows = <6>;                                                             \
        columns = <16>;                                                         \
        map = <_alpha _bottom>;                                                 \
    };

/*
 * Rows 0-4 keycap geometry, ANSI (1u = 100).
 *   Row 0: Esc, F1-F12, PrtSc, ScrLk, Pause (16 keys, y=0)
 *   Row 1: `, 1-0, -, =, Bksp 2u, Ins, Home, PgUp (17 keys, y=125)
 *   Row 2: Tab 1.5u, QWERTY, [, ], \ 1.5u, Del, End, PgDn (17 keys, y=225)
 *   Row 3: Caps 1.75u, ASDF, ;, ', Enter 2.25u (13 keys, y=325)
 *   Row 4: LShift 2.25u, ZXCV, RShift 2.75u, Up (13 keys, y=425)
 */
#define KEYS_ALPHA_ANSI                                                         \
    <&key_physical_attrs 100 100    0    0 0 0 0>,                              \
    <&key_physical_attrs 100 100  200    0 0 0 0>,                              \
    <&key_physical_attrs 100 100  300    0 0 0 0>,                              \
    <&key_physical_attrs 100 100  400    0 0 0 0>,                              \
    <&key_physical_attrs 100 100  500    0 0 0 0>,                              \
    <&key_physical_attrs 100 100  650    0 0 0 0>,                              \
    <&key_physical_attrs 100 100  750    0 0 0 0>,                              \
    <&key_physical_attrs 100 100  850    0 0 0 0>,                              \
    <&key_physical_attrs 100 100  950    0 0 0 0>,                              \
    <&key_physical_attrs 100 100 1100    0 0 0 0>,                              \
    <&key_physical_attrs 100 100 1200    0 0 0 0>,                              \
    <&key_physical_attrs 100 100 1300    0 0 0 0>,                              \
    <&key_physical_attrs 100 100 1400    0 0 0 0>,                              \
    <&key_physical_attrs 100 100 1525    0 0 0 0>,                              \
    <&key_physical_attrs 100 100 1625    0 0 0 0>,                              \
    <&key_physical_attrs 100 100 1725    0 0 0 0>,                              \
    <&key_physical_attrs 100 100    0  125 0 0 0>,                              \
    <&key_physical_attrs 100 100  100  125 0 0 0>,                              \
    <&key_physical_attrs 100 100  200  125 0 0 0>,                              \
    <&key_physical_attrs 100 100  300  125 0 0 0>,                              \
    <&key_physical_attrs 100 100  400  125 0 0 0>,                              \
    <&key_physical_attrs 100 100  500  125 0 0 0>,                              \
    <&key_physical_attrs 100 100  600  125 0 0 0>,                              \
    <&key_physical_attrs 100 100  700  125 0 0 0>,                              \
    <&key_physical_attrs 100 100  800  125 0 0 0>,                              \
    <&key_physical_attrs 100 100  900  125 0 0 0>,                              \
    <&key_physical_attrs 100 100 1000  125 0 0 0>,                              \
    <&key_physical_attrs 100 100 1100  125 0 0 0>,                              \
    <&key_physical_attrs 100 100 1200  125 0 0 0>,                              \
    <&key_physical_attrs 200 100 1300  125 0 0 0>,                              \
    <&key_physical_attrs 100 100 1525  125 0 0 0>,                              \
    <&key_physical_attrs 100 100 1625  125 0 0 0>,                              \
    <&key_physical_attrs 100 100 1725  125 0 0 0>,                              \
    <&key_physical_attrs 150 100    0  225 0 0 0>,                              \
    <&key_physical_attrs 100 100  150  225 0 0 0>,                              \
    <&key_physical_attrs 100 100  250  225 0 0 0>,                              \
    <&key_physical_attrs 100 100  350  225 0 0 0>,                              \
    <&key_physical_attrs 100 100  450  225 0 0 0>,                              \
    <&key_physical_attrs 100 100  550  225 0 0 0>,                              \
    <&key_physical_attrs 100 100  650  225 0 0 0>,                              \
    <&key_physical_attrs 100 100  750  225 0 0 0>,                              \
    <&key_physical_attrs 100 100  850  225 0 0 0>,                              \
    <&key_physical_attrs 100 100  950  225 0 0 0>,                              \
    <&key_physical_attrs 100 100 1050  225 0 0 0>,                              \
    <&key_physical_attrs 100 100 1150  225 0 0 0>,                              \
    <&key_physical_attrs 100 100 1250  225 0 0 0>,                              \
    <&key_physical_attrs 150 100 1350  225 0 0 0>,                              \
    <&key_physical_attrs 100 100 1525  225 0 0 0>,                              \
    <&key_physical_attrs 100 100 1625  225 0 0 0>,                              \
    <&key_physical_attrs 100 100 1725  225 0 0 0>,                              \
    <&key_physical_attrs 175 100    0  325 0 0 0>,                              \
    <&key_physical_attrs 100 100  175  325 0 0 0>,                              \
    <&key_physical_attrs 100 100  275  325 0 0 0>,                              \
    <&key_physical_attrs 100 100  375  325 0 0 0>,                              \
    <&key_physical_attrs 100 100  475  325 0 0 0>,                              \
    <&key_physical_attrs 100 100  575  325 0 0 0>,                              \
    <&key_physical_attrs 100 100  675  325 0 0 0>,                              \
    <&key_physical_attrs 100 100  775  325 0 0 0>,                              \
    <&key_physical_attrs 100 100  875  325 0 0 0>,                              \
    <&key_physical_attrs 100 100  975  325 0 0 0>,                              \
    <&key_physical_attrs 100 100 1075  325 0 0 0>,                              \
    <&key_physical_attrs 100 100 1175  325 0 0 0>,                              \
    <&key_physical_attrs 225 100 1275  325 0 0 0>,                              \
    <&key_physical_attrs 225 100    0  425 0 0 0>,                              \
    <&key_physical_attrs 100 100  225  425 0 0 0>,                              \
    <&key_physical_attrs 100 100  325  425 0 0 0>,                              \
    <&key_physical_attrs 100 100  425  425 0 0 0>,                              \
    <&key_physical_attrs 100 100  525  425 0 0 0>,                              \
    <&key_physical_attrs 100 100  625  425 0 0 0>,                              \
    <&key_physical_attrs 100 100  725  425 0 0 0>,                              \
    <&key_physical_attrs 100 100  825  425 0 0 0>,                              \
    <&key_physical_attrs 100 100  925  425 0 0 0>,                              \
    <&key_physical_attrs 100 100 1025  425 0 0 0>,                              \
    <&key_physical_attrs 100 100 1125  425 0 0 0>,                              \
    <&key_physical_attrs 275 100 1225  425 0 0 0>,                              \
    <&key_physical_attrs 100 100 1625  425 0 0 0>

/*
 * 87U bottom: LCtrl 1.5u / LGui 1u / LAlt 1.5u / Space 6u / RAlt 1.5u /
 * RGui 1u / Menu 1u / RCtrl 1.5u + arrows. y=525.
 */
#define KEYS_BOTTOM_87U                                                         \
    <&key_physical_attrs 150 100    0  525 0 0 0>,                              \
    <&key_physical_attrs 100 100  150  525 0 0 0>,                              \
    <&key_physical_attrs 150 100  250  525 0 0 0>,                              \
    <&key_physical_attrs 600 100  400  525 0 0 0>,                              \
    <&key_physical_attrs 150 100 1000  525 0 0 0>,                              \
    <&key_physical_attrs 100 100 1150  525 0 0 0>,                              \
    <&key_physical_attrs 100 100 1250  525 0 0 0>,                              \
    <&key_physical_attrs 150 100 1350  525 0 0 0>,                              \
    <&key_physical_attrs 100 100 1525  525 0 0 0>,                              \
    <&key_physical_attrs 100 100 1625  525 0 0 0>,                              \
    <&key_physical_attrs 100 100 1725  525 0 0 0>

#define PHYS_LAYOUT(_name, _display, _xform, _alpha, _bottom)                   \
    _name: _name {                                                              \
        compatible = "zmk,physical-layout";                                     \
        display-name = _display;                                                \
        transform = <&_xform>;                                                  \
        kscan = <&kscan0>;                                                      \
        keys = _alpha, _bottom;                                                 \
    };

/ {
    TRANSFORM(transform_87u, XFORM_ALPHA_ANSI, XFORM_BOTTOM_87U)

    PHYS_LAYOUT(layout_87u, "Realforce 87U", transform_87u, KEYS_ALPHA_ANSI, KEYS_BOTTOM_87U)
};
